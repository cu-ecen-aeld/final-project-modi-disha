## base_external/Config.in
```kconfig
source "$BR2_EXTERNAL_assignment_base_PATH/package/socketcomm/Config.in"
source "$BR2_EXTERNAL_assignment_base_PATH/package/aesdgpio/Config.in"
source "$BR2_EXTERNAL_assignment_base_PATH/package/aesdi2c/Config.in"
source "$BR2_EXTERNAL_assignment_base_PATH/package/aesdlcd/Config.in"
```

## base_external/package/aesdgpio/Config.in
```kconfig
config BR2_PACKAGE_AESDGPIO
	bool "AESDGPIO"
	help
	  Includes the writer executable, finder.sh and tester.sh in the kernel image.
	  Used to understand buildroot external trees and package builds.
```

## base_external/package/aesdi2c/Config.in
```kconfig
config BR2_PACKAGE_AESDI2C
        bool "aesdi2c"
        help
                Linux Kernel Module.
```

## base_external/package/gpiomodule/Config.in
```kconfig
config BR2_PACKAGE_GPIOMODULE
        bool "gpiomodule"
        help
                Linux Kernel Module Cheat.
```

## base_external/package/socketcomm/Config.in
```kconfig
config BR2_PACKAGE_SOCKETCOMM
	bool "SOCKETCOMM"
	help
	  Includes the writer executable, finder.sh and tester.sh in the kernel image.
	  Used to understand buildroot external trees and package builds.
```
